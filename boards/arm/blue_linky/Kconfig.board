## boards/arm/blue_linky/Kconfig.board
```kconfig
# Blue Linky board configuration

# Copyright (c) 2021 Thibaud Rouillé
# SPDX-License-Identifier: Apache-2.0

config BOARD_BLUE_LINKY
	bool "Blue Linky"
	depends on SOC_NRF52840_QIAA
```
